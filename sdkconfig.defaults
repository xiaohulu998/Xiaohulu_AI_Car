## sdkconfig.defaults
```kconfig
# 手机浏览器（尤其微信/Chrome）请求头常超过默认 512 字节，
# 会导致 httpd 返回 431 Request Header Fields Too Large
CONFIG_HTTPD_MAX_REQ_HDR_LEN=2048
CONFIG_HTTPD_MAX_URI_LEN=1024
CONFIG_HTTPD_WS_SUPPORT=y
```
